## pkgsrc/sysutils/u-boot-source/files/board/espressif/esp32s31/Kconfig
```kconfig
if TARGET_ESP32S31

config SYS_BOARD
	default "esp32s31"

config SYS_VENDOR
	default "espressif"

config SYS_CPU
	default "generic"

config SYS_CONFIG_NAME
	default "esp32s31"

config BOARD_SPECIFIC_OPTIONS
	def_bool y
	select GENERIC_RISCV
	select SUPPORT_SPL

config ESP32S31_NOR_MAP
	bool "Map unencrypted 16 MiB NOR for SPL reads"
	depends on SPL
	help
	  Map the flash-side MMU before PSRAM initialization. Flash
	  encryption is not supported by this profile.

config ESP32S31_NOR_PROBE
	bool "Print a read-only checksum of mapped NOR"
	depends on ESP32S31_NOR_MAP
	depends on !ESP32S31_NOR_BOOT
	select SPL_CRC32
	help
	  For RAM-launched diagnostics, checksum two 4 KiB regions before
	  receiving the next firmware image over UART.

config ESP32S31_NOR_BOOT
	bool "Boot the mapped NOR FIT before UART recovery"
	depends on ESP32S31_NOR_MAP && SPL_NOR_SUPPORT

endif
```

## pkgsrc/sysutils/u-boot-source/files/board/espressif/esp32s31/firmware.its
```
// SPDX-License-Identifier: GPL-2.0+
/dts-v1/;
/ {
    description = "ESP32-S31 RAM firmware";
    #address-cells = <1>;
    images {
        firmware {
            description = "OpenSBI dynamic";
            data = /incbin/("opensbi.bin");
            type = "firmware";
            arch = "riscv";
            os = "opensbi";
            compression = "none";
            load = <0x2f000000>;
            entry = <0x2f000000>;
            hash { algo = "sha256"; };
        };
        uboot {
            description = "U-Boot proper";
            data = /incbin/("u-boot.bin");
            type = "firmware";
            arch = "riscv";
            os = "u-boot";
            compression = "none";
            load = <0x50400000>;
            entry = <0x50400000>;
            hash { algo = "sha256"; };
        };
        fdt {
            description = "S31 firmware FDT";
            data = /incbin/("firmware.dtb");
            type = "flat_dt";
            arch = "riscv";
            compression = "none";
            load = <0x50430000>;
            hash { algo = "sha256"; };
        };
    };
    configurations {
        default = "conf";
        conf {
            description = "ESP32-S31 OpenSBI and U-Boot";
            firmware = "firmware";
            fdt = "fdt";
            loadables = "uboot";
        };
    };
};
```

## pkgsrc/sysutils/u-boot-source/files/board/espressif/esp32s31/nor-firmware.its
```
// SPDX-License-Identifier: GPL-2.0+
/dts-v1/;
/ {
    description = "ESP32-S31 NOR firmware and RAM root";
    #address-cells = <1>;
    images {
        firmware { description = "OpenSBI dynamic"; data = /incbin/("opensbi.bin"); type = "firmware"; arch = "riscv"; os = "opensbi"; compression = "none"; load = <0x2f000000>; entry = <0x2f000000>; hash { algo = "sha256"; }; };
        uboot { description = "U-Boot proper"; data = /incbin/("u-boot.bin"); type = "firmware"; arch = "riscv"; os = "u-boot"; compression = "none"; load = <0x50400000>; entry = <0x50400000>; hash { algo = "sha256"; }; };
        fdt { description = "Firmware FDT"; data = /incbin/("firmware.dtb"); type = "flat_dt"; arch = "riscv"; compression = "none"; load = <0x50430000>; hash { algo = "sha256"; }; };
        root { description = "RAM root filesystem"; data = /incbin/("root.fs"); type = "firmware"; arch = "riscv"; compression = "none"; load = <0x50000000>; hash { algo = "sha256"; }; };
        kernel { description = "Nested kernel FIT"; data = /incbin/("kernel.itb"); type = "firmware"; arch = "riscv"; compression = "none"; load = <0x50c00000>; hash { algo = "sha256"; }; };
    };
    configurations {
        default = "conf";
        conf { description = "ESP32-S31 NOR"; firmware = "firmware"; fdt = "fdt"; loadables = "uboot", "root", "kernel"; };
    };
};
```

## pkgsrc/sysutils/u-boot-source/files/configs/espressif_esp32s31_defconfig
```kconfig
CONFIG_RISCV=y
CONFIG_NR_CPUS=2
CONFIG_SYS_ICACHE_OFF=y
CONFIG_SYS_DCACHE_OFF=y
CONFIG_TEXT_BASE=0x50400000
CONFIG_SYS_MALLOC_LEN=0x18000
CONFIG_SYS_MALLOC_F_LEN=0x2000
CONFIG_NR_DRAM_BANKS=2
CONFIG_HAS_CUSTOM_SYS_INIT_SP_ADDR=y
CONFIG_CUSTOM_SYS_INIT_SP_ADDR=0x2F07A000
CONFIG_ENV_SIZE=0x2000
CONFIG_DEFAULT_DEVICE_TREE="esp32s31"
CONFIG_SPL_TEXT_BASE=0x2F040000
CONFIG_SPL_SYS_MALLOC_F_LEN=0x20000
CONFIG_SPL_BSS_START_ADDR=0x2F050000
CONFIG_SPL_BSS_MAX_SIZE=0x8000
CONFIG_SPL_LDSCRIPT="board/espressif/esp32s31/u-boot-spl.lds"
CONFIG_SPL=y
CONFIG_SYS_LOAD_ADDR=0x50000000
CONFIG_ARCH_ESPRESSIF=y
CONFIG_SPL_OPENSBI_LOAD_ADDR=0x2F000000
CONFIG_CMODEL_MEDANY=y
CONFIG_RISCV_SMODE=y
# CONFIG_RISCV_ISA_F is not set
CONFIG_FIT=y
CONFIG_SPL_LOAD_FIT=y
CONFIG_SPL_OPENSBI=y
# CONFIG_BOOTSTD is not set
CONFIG_BOOTDELAY=-1
# CONFIG_USE_BOOTCOMMAND is not set
CONFIG_BOARD_LATE_INIT=y
CONFIG_SPL_MAX_SIZE=0x10000
CONFIG_SPL_SIZE_LIMIT=0x10000
CONFIG_SPL_BOARD_INIT=y
CONFIG_SPL_SERIAL=y
CONFIG_SPL_YMODEM_SUPPORT=y
# CONFIG_AUTO_COMPLETE is not set
# CONFIG_SYS_LONGHELP is not set
CONFIG_SYS_PROMPT="esp32s31> "
# CONFIG_CMD_CONSOLE is not set
# CONFIG_CMD_BOOTD is not set
CONFIG_CMD_BOOTM=y
CONFIG_BOOTM_NETBSD=y
# CONFIG_CMD_ELF is not set
# CONFIG_CMD_FDT is not set
# CONFIG_CMD_GO is not set
# CONFIG_CMD_IMI is not set
# CONFIG_CMD_XIMG is not set
# CONFIG_CMD_CRC32 is not set
CONFIG_CMD_MEMTEST=y
# CONFIG_CMD_LZMADEC is not set
# CONFIG_CMD_UNLZ4 is not set
# CONFIG_CMD_UNZIP is not set
# CONFIG_CMD_DM is not set
CONFIG_CMD_LOADB=y
# CONFIG_CMD_LOADS is not set
# CONFIG_CMD_SOURCE is not set
# CONFIG_CMD_SETEXPR is not set
CONFIG_OF_BOARD=y
# CONFIG_NET is not set
CONFIG_SPL_CLK=y
CONFIG_ESP_SERIAL=y
CONFIG_SHA256=y
CONFIG_GZIP=y
CONFIG_SYS_BOOTM_LEN=0x600000
# CONFIG_EFI_LOADER is not set

CONFIG_SUPPORT_RAW_INITRD=y

CONFIG_SPL_FIT_HASH_VERIFY=y
CONFIG_SPL_SHA256_SMALL=y
# CONFIG_SPL_SHA1 is not set
# CONFIG_SPL_USE_ARCH_MEMCPY is not set
# CONFIG_SPL_USE_ARCH_MEMMOVE is not set
# CONFIG_SPL_USE_ARCH_MEMSET is not set
CONFIG_SPL_TINY_MEMSET=y

# CONFIG_SPL_RAW_IMAGE_SUPPORT is not set
```
