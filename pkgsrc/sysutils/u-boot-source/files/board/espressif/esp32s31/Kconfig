## pkgsrc/sysutils/u-boot-source/files/board/espressif/esp32s31/Kconfig
```kconfig
if TARGET_ESP32S31

config SYS_BOARD
	default "esp32s31"

config SYS_VENDOR
	default "espressif"

config SYS_CPU
	default "generic"

config SYS_CONFIG_NAME
	default "esp32s31"

config BOARD_SPECIFIC_OPTIONS
	def_bool y
	select GENERIC_RISCV
	select SUPPORT_SPL

config ESP32S31_NOR_MAP
	bool "Map unencrypted 16 MiB NOR for SPL reads"
	depends on SPL
	help
	  Map the flash-side MMU before PSRAM initialization. Flash
	  encryption is not supported by this profile.

config ESP32S31_NOR_PROBE
	bool "Print a read-only checksum of mapped NOR"
	depends on ESP32S31_NOR_MAP
	depends on !ESP32S31_NOR_BOOT
	select SPL_CRC32
	help
	  For RAM-launched diagnostics, checksum two 4 KiB regions before
	  receiving the next firmware image over UART.

config ESP32S31_NOR_BOOT
	bool "Boot the mapped NOR FIT before UART recovery"
	depends on ESP32S31_NOR_MAP && SPL_NOR_SUPPORT

config ESP32S31_MOSAICO_PANEL
	bool

config ESP32S31_MOSAICO_SPLASH
	bool "Enable the opt-in Mosaico LCD splash diagnostic command"
	depends on CMDLINE
	select ESP32S31_MOSAICO_PANEL
	default n
	help
	  Add the mosaicosplash command to U-Boot proper for an explicit
	  pre-kernel LCD diagnostic. It is never run automatically.

config ESP32S31_MOSAICO_BOOT_DISPLAY
	bool "Show the EmberBSD logo and boot stages on the Mosaico display"
	depends on BOARD_LATE_INIT
	select ESP32S31_MOSAICO_PANEL
	select SHOW_BOOT_PROGRESS
	help
	  Enable on Mosaico boards with the 480x480 CO5300. The display starts
	  in U-Boot proper and follows bootm events. UART remains available.

endif
```
